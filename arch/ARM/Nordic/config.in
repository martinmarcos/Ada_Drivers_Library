## arch/ARM/Nordic/config.in
```kconfig
config DEVICE_NRF51
       bool
       select ARM_CORTEX_M0

       # Sources
       option source_dir="arch/ARM/Nordic/drivers"
       option source_dir="arch/ARM/Nordic/devices"
       option source_dir="arch/ARM/Nordic/svd/nrf51"
```

## boards/config.in
```kconfig
config HAS_RUNTIME_PROFILE_ZFP
       bool
config HAS_RUNTIME_PROFILE_RAVENSCAR_SFP
       bool
config HAS_RUNTIME_PROFILE_RAVENSCAR_FULL
       bool
config HAS_RUNTIME_PROFILE_NATIVE
       bool

config BOARD_STM32F4_DISCO
       bool
       select DEVICE_STM32F40X

       select HAS_RUNTIME_PROFILE_ZFP
       select HAS_RUNTIME_PROFILE_RAVENSCAR_SFP
       select HAS_RUNTIME_PROFILE_RAVENSCAR_FULL

       # Sources
       option source_dir="boards/stm32_common/stm32f407disco"
       option source_dir="boards/stm32_common/common"

if BOARD_STM32F4_DISCO
   config RUNTIME_NAME_SUFFIX
          string
          default "stm32f4"

   config STM32_HSE_MHZ
          int
          default 8

endif

config BOARD_CRAZYFLIE2
       bool
       select DEVICE_STM32F40X

       select HAS_RUNTIME_PROFILE_ZFP
       select HAS_RUNTIME_PROFILE_RAVENSCAR_SFP
       select HAS_RUNTIME_PROFILE_RAVENSCAR_FULL

       # Sources
       option source_dir="boards/crazyflie/src"

if BOARD_CRAZYFLIE2
   config RUNTIME_NAME_SUFFIX
          string
          default "stm32f4"

   config STM32_HSE_MHZ
          int
          default 8

endif

config BOARD_STM32F429_DISCO
       bool
       select DEVICE_STM32F429

       select HAS_RUNTIME_PROFILE_ZFP
       select HAS_RUNTIME_PROFILE_RAVENSCAR_SFP
       select HAS_RUNTIME_PROFILE_RAVENSCAR_FULL

       # Sources
       option source_dir="boards/stm32_common/stm32f429disco"
       option source_dir="boards/stm32_common/common"
       option source_dir="boards/stm32_common/dma2d"
       option source_dir="boards/stm32_common/ltdc"
       option source_dir="boards/stm32_common/sdram"

if BOARD_STM32F429_DISCO
   config RUNTIME_NAME_SUFFIX
          string
          default "stm32f429disco"

   config STM32_HSE_MHZ
          int
          default 8

endif

config BOARD_OPENMV2
       bool
       select DEVICE_STM32F427

       select HAS_RUNTIME_PROFILE_ZFP
       select HAS_RUNTIME_PROFILE_RAVENSCAR_SFP
       select HAS_RUNTIME_PROFILE_RAVENSCAR_FULL

       # Sources
       option source_dir="boards/OpenMV2/src"

if BOARD_OPENMV2
   config RUNTIME_NAME_SUFFIX
          string
          default "openmv2"

   config STM32_HSE_MHZ
          int
          default 12
endif

config BOARD_STM32F469_DISCO
       bool
       select DEVICE_STM32F46_79X

       select HAS_RUNTIME_PROFILE_ZFP
       select HAS_RUNTIME_PROFILE_RAVENSCAR_SFP
       select HAS_RUNTIME_PROFILE_RAVENSCAR_FULL

       # Sources
       option source_dir="boards/stm32_common/stm32f469disco"
       option source_dir="boards/stm32_common/common"
       option source_dir="boards/stm32_common/dma2d"
       option source_dir="boards/stm32_common/otm80909a"
       option source_dir="boards/stm32_common/sdcard"
       option source_dir="boards/stm32_common/sdram"

if BOARD_STM32F469_DISCO
   config RUNTIME_NAME_SUFFIX
          string
          default "stm32f469disco"

   config STM32_HSE_MHZ
          int
          default 8

endif

config BOARD_STM32F746_DISCO
       bool
       select DEVICE_STM32F7X

       select HAS_RUNTIME_PROFILE_ZFP
       select HAS_RUNTIME_PROFILE_RAVENSCAR_SFP
       select HAS_RUNTIME_PROFILE_RAVENSCAR_FULL

       # Sources
       option source_dir="boards/stm32_common/stm32f746disco"
       option source_dir="boards/stm32_common/common"
       option source_dir="boards/stm32_common/dma2d"
       option source_dir="boards/stm32_common/ltdc"
       option source_dir="boards/stm32_common/sdcard"
       option source_dir="boards/stm32_common/sdram"

if BOARD_STM32F746_DISCO
   config RUNTIME_NAME_SUFFIX
          string
          default "stm32f746disco"

   config STM32_HSE_MHZ
          int
          default 25

endif

config BOARD_STM32F769_DISCO
       bool
       select DEVICE_STM32F7X9

       select HAS_RUNTIME_PROFILE_ZFP
       select HAS_RUNTIME_PROFILE_RAVENSCAR_SFP
       select HAS_RUNTIME_PROFILE_RAVENSCAR_FULL

       # Sources
       option source_dir="boards/stm32_common/stm32f769disco"
       option source_dir="boards/stm32_common/common"
       option source_dir="boards/stm32_common/dma2d"
       option source_dir="boards/stm32_common/otm8009a"
       option source_dir="boards/stm32_common/sdcard"
       option source_dir="boards/stm32_common/sdram"

if BOARD_STM32F769_DISCO
   config RUNTIME_NAME_SUFFIX
          string
          default "stm32f769disco"

   config STM32_HSE_MHZ
          int
          default 25

endif

config BOARD_MICRO_BIT
       bool
       select DEVICE_NRF51

       select HAS_RUNTIME_PROFILE_ZFP
       select HAS_BOARD_DELAY_SUPPORT

       # Sources
       option source_dir="boards/MicroBit/src"

if BOARD_MICRO_BIT
   config RUNTIME_NAME_SUFFIX
          string
          default "nrf51"
endif

config BOARD_NATIVE
       bool

       select HAS_RUNTIME_PROFILE_NATIVE

       # Sources
       option source_dir="boards/native/src/"

if BOARD_NATIVE
   config RUNTIME_NAME_SUFFIX
          string
          default ""
endif

config BOARD_HIFIVE1
       bool
       select DEVICE_FE310

       select HAS_RUNTIME_PROFILE_ZFP

       # Sources
       option source_dir="boards/HiFive1/src"

if BOARD_HIFIVE1
   config RUNTIME_NAME_SUFFIX
          string
          default "hifive1"
endif


###########
# Choices #
###########

menu "Board"

   config HAS_BOARD_DELAY_SUPPORT
          bool

   config ARCH_RISCV
          bool

   ####################
   # Supported boards #
   ####################
   choice
           prompt "Board variant"
           default CHOICE_BOARD_CUSTOM
           help
             Specific board variant to use

      config CHOICE_BOARD_CUSTOM
              bool "Custom board definition"

      config CHOICE_BOARD_NATIVE
              bool "Native board"
              select BOARD_NATIVE
              help
                Used for testing or for Raspberry-Pi support

      config CHOICE_BOARD_STM32F4_DISCO
              bool "STM32F4 Discovery"
              select BOARD_STM32F4_DISCO

      config CHOICE_BOARD_CRAZYFLIE2
              bool "Crazyflie 2.0 Nano drone from Bitcraze"
              select BOARD_CRAZYFLIE2

      config CHOICE_BOARD_STM32F429_DISCO
              bool "STM32F429 Discovery"
              select BOARD_STM32F429_DISCO

      config CHOICE_BOARD_OPENMV2
              bool "OpenMV 2"
              select BOARD_OPENMV2

      config CHOICE_BOARD_STM32F469_DISCO
              bool "STM32F469 Discovery"
              select BOARD_STM32F469_DISCO

      config CHOICE_BOARD_STM32F746_DISCO
              bool "STM32F746 Discovery"
              select BOARD_STM32F746_DISCO

      config CHOICE_BOARD_STM32F769_DISCO
              bool "STM32F769 Discovery"
              select BOARD_STM32F769_DISCO

      config CHOICE_BOARD_MICROBIT
              bool "BBC Micro:Bit"
              select BOARD_MICRO_BIT

      config CHOICE_BOARD_HIFIVE1
              bool "SiFive HiFive 1"
              select BOARD_HIFIVE1
   endchoice

   if CHOICE_BOARD_CUSTOM

      config BOARD_CUSTOM_SOURCE_DIR
             string "Source directory for the custom board support"

      choice
              prompt "Target Micro-controller familly Variant"
              default CHOICE_SELECT_MCU_STM32
              help
                Specific CPU variant to use
         config CHOICE_SELECT_MCU_CUSTOM
                 bool "Custom MCU definition"
         config CHOICE_SELECT_MCU_STM32
                 bool "STMicro STM32"
         config CHOICE_SELECT_MCU_SIFIVE
                 bool "SiFive RISC-V 32"
         config CHOICE_SELECT_MCU_NORDIC
                 bool "Nordic NRF5x"
      endchoice
   endif

source "arch/config.choices"

endmenu
```

## components/config.in
```kconfig
config HAS_COMPONENTS
       def_bool y

       # Sources
       option source_dir="components/src/**"
```

## config.in
```kconfig
# mainmenu "Ada_Drivers_Library Configuration"

config HARDWARE_ABSTRACTION_LAYER
       def_bool y

       # Sources
       option source_dir="hal/src/**"

source "arch/config.in"
source "boards/config.in"
source "middleware/config.in"
source "components/config.in"
```

## middleware/config.in
```kconfig
menu "Middleware"

config MIDDLEWARE
       def_bool y

       # Sources
       option source_dir="middleware/src/audio"
       option source_dir="middleware/src/bitmap"
       option source_dir="middleware/src/BLE"
       option source_dir="middleware/src/filesystem"
       option source_dir="middleware/src/monitor"
       option source_dir="middleware/src/utils"
       option source_dir="middleware/sdmmc/"

config MIDDLEWARE_RAVENSCAR
       def_bool y

       depends on RUNTIME_PROFILE_RAVENSCAR_FULL || RUNTIME_PROFILE_RAVENSCAR_SFP

       # Sources
       option source_dir="middleware/src/ravenscar-common"

menu "Filesystem"
      config FILESYSTEM_MAX_PATH_LEN
             int "Maximun path length"
             default "1024"
             range "1" "2048"

endmenu
endmenu
```
